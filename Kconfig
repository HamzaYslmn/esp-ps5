## Kconfig
```kconfig
menu ps5

    choice IDF_COMPATIBILITY
        prompt "Framework compatibility"
        default IDF_COMPATIBILITY_STABLE
        help
            The esp-ps5 library uses internal Bluedroid APIs whose headers
            are not exposed by the public ESP-IDF API. The headers in
            src/stack and src/osi are vendored copies. Pick the option
            that matches your installed ESP-IDF revision.

        config IDF_COMPATIBILITY_STABLE
            bool "Latest stable release"
        config IDF_COMPATIBILITY_MASTER
            bool "Latest master revision"
    endchoice

    config IDF_COMPATIBILITY
        int
        default 1 if IDF_COMPATIBILITY_STABLE
        default 3 if IDF_COMPATIBILITY_MASTER

endmenu
```
